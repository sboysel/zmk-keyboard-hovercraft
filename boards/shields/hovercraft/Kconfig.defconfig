## boards/shields/hovercraft/Kconfig.defconfig
```kconfig
if SHIELD_HOVERCRAFT_LEFT

# Name must be less than 16 characters long!
config ZMK_KEYBOARD_NAME
    default "hovercraft"

config ZMK_SPLIT_ROLE_CENTRAL
    default y

endif

if SHIELD_HOVERCRAFT_LEFT || SHIELD_HOVERCRAFT_RIGHT

config ZMK_SPLIT
    default y

endif
```

## boards/shields/hovercraft/Kconfig.shield
```kconfig
# No whitespace after the comma or in your part name!
config SHIELD_HOVERCRAFT_LEFT
    def_bool $(shields_list_contains,hovercraft_left)

# No whitespace after the comma or in your part name!
config SHIELD_HOVERCRAFT_RIGHT
    def_bool $(shields_list_contains,hovercraft_right)
```
